/* code generated by beremiz OPC-UA server extension */

#include <open62541/server.h>
#include <open62541/server_config_default.h>
#include <open62541/plugin/accesscontrol_default.h>

#include <stdint.h>
#include <stdatomic.h>
#include <pthread.h>
#include <dlfcn.h>
#include <string.h>
#include <ctype.h>
#include <stdio.h>

#include "iec_types_all.h"
#include "beremiz.h"

#define _Log(level, ...)                                                                           \
    {                                                                                              \
        char mstr[256];                                                                            \
        snprintf(mstr, 255, __VA_ARGS__);                                                          \
        LogMessage(level, mstr, strlen(mstr));                                                     \
    }

#define LogInfo(...) _Log(LOG_INFO, __VA_ARGS__);
#define LogError(...) _Log(LOG_CRITICAL, __VA_ARGS__);
#define LogWarning(...) _Log(LOG_WARNING, __VA_ARGS__);

%(crypto)s

/* Published PLC variable, nodeContext of variable nodes.
 * gen is the logic generation the pointer belongs to. */
typedef struct {
    void *ptr;
    __IEC_types_enum type;
    uint32_t gen;
} opcua_var_t;

#define __Unpack_desc_type opcua_var_t

%(var_access_code)s

/* Room for the value of any elementary IEC type */
typedef union {
    IEC_STRING s;
    IEC_TIME t;
    IEC_LWORD l;
    IEC_LREAL d;
} opcua_value_t;

static UA_Server *server = NULL;
static pthread_t server_thread;
static volatile UA_Boolean server_running = false;
static UA_UInt16 ns;
static const UA_NodeId root_id = {0, UA_NODEIDTYPE_NUMERIC, {1}};

/*
 * Logic generations.
 * __logic_bound_ resolves ScanInstances of a logic .so about to be activated,
 * __logic_active_ makes it current and increments active_gen. Server thread
 * then rebuilds the node set, and stamps published variables with built_gen.
 */
typedef int (*scan_cb_t)(__IEC_types_enum, void *, unsigned int, unsigned int,
                         unsigned int, const char *, void *);
typedef void (*scan_fn_t)(scan_cb_t cb, void *userdata, int config_only);
static scan_fn_t pending_scan = NULL;
static scan_fn_t active_scan = NULL;
static atomic_uint active_gen = 0;
static uint32_t built_gen = 0;
static int building = 0;

/*
 * Read access: server thread locks rd_mutex while copying a value.
 * PLC tries to lock it in retrieve and keeps it until publish. If it fails,
 * the PLC runs anyway but flags the read as interrupted, so that reader
 * waits for the end of PLC cycle, and tries again.
 */
static pthread_mutex_t rd_mutex = PTHREAD_MUTEX_INITIALIZER;
static atomic_int rd_interrupted = 0;
/* When PLC cannot lock rd_mutex, it locks cycle_end_mutex instead, until
 * publish. Reader holding rd_mutex at that time never holds cycle_end_mutex,
 * so that PLC's trylock doesn't fail, unless reader is already waiting. */
static pthread_mutex_t cycle_end_mutex = PTHREAD_MUTEX_INITIALIZER;
enum { PLC_IDLE, PLC_LOCKED, PLC_INTERRUPTING };
static int plc_locked = PLC_IDLE;
extern IEC_TIME __CURRENT_TIME;

static void wait_plc_cycle_end(void)
{
    pthread_mutex_lock(&cycle_end_mutex);
    pthread_mutex_unlock(&cycle_end_mutex);
}

/*
 * Write access: buffered by server thread, applied by PLC in retrieve.
 */
#define WRITE_QUEUE_SIZE 128
typedef struct {
    opcua_var_t var;
    opcua_value_t value;
} opcua_write_t;
static opcua_write_t write_queue[WRITE_QUEUE_SIZE];
static unsigned int write_count = 0;
static uint32_t write_lock = 0;

/* Variable descriptors are allocated in blocks, so that nodeContext pointers
 * stay valid while node set grows. */
#define VAR_BLOCK_SIZE 256
typedef struct var_block_s {
    struct var_block_s *next;
    unsigned int used;
    opcua_var_t vars[VAR_BLOCK_SIZE];
} var_block_t;
static var_block_t *var_blocks = NULL;
static unsigned int var_count = 0;

static opcua_var_t *new_var(void)
{
    if(!var_blocks || var_blocks->used == VAR_BLOCK_SIZE){
        var_block_t *block = calloc(1, sizeof(var_block_t));
        if(!block) return NULL;
        block->next = var_blocks;
        var_blocks = block;
    }
    var_count++;
    return &var_blocks->vars[var_blocks->used++];
}

static void free_vars(void)
{
    while(var_blocks){
        var_block_t *next = var_blocks->next;
        free(var_blocks);
        var_blocks = next;
    }
    var_count = 0;
}

/*
 * IEC <-> OPC-UA type mapping, following OPC 30000 (PLCopen) Table 27
 */
#define __base_case_p(TYPENAME)                                             \
        case TYPENAME##_O_ENUM :                                            \
        case TYPENAME##_P_ENUM :                                            \
            return TYPENAME##_ENUM;

static __IEC_types_enum base_type(__IEC_types_enum type)
{
    switch(type){
        __ANY(__base_case_p)
        __base_case_p(ENUM)
        default:
            return type;
    }
}

static const UA_DataType *ua_type(__IEC_types_enum type)
{
    switch(base_type(type)){
        case BOOL_ENUM:  return &UA_TYPES[UA_TYPES_BOOLEAN];
        case SINT_ENUM:  return &UA_TYPES[UA_TYPES_SBYTE];
        case INT_ENUM:   return &UA_TYPES[UA_TYPES_INT16];
        case DINT_ENUM:  return &UA_TYPES[UA_TYPES_INT32];
        case LINT_ENUM:  return &UA_TYPES[UA_TYPES_INT64];
        case USINT_ENUM: return &UA_TYPES[UA_TYPES_BYTE];
        case UINT_ENUM:  return &UA_TYPES[UA_TYPES_UINT16];
        case UDINT_ENUM: return &UA_TYPES[UA_TYPES_UINT32];
        case ULINT_ENUM: return &UA_TYPES[UA_TYPES_UINT64];
        case BYTE_ENUM:  return &UA_TYPES[UA_TYPES_BYTE];
        case WORD_ENUM:  return &UA_TYPES[UA_TYPES_UINT16];
        case DWORD_ENUM: return &UA_TYPES[UA_TYPES_UINT32];
        case LWORD_ENUM: return &UA_TYPES[UA_TYPES_UINT64];
        case REAL_ENUM:  return &UA_TYPES[UA_TYPES_FLOAT];
        case LREAL_ENUM: return &UA_TYPES[UA_TYPES_DOUBLE];
        case TIME_ENUM:  return &UA_TYPES[UA_TYPES_INT64];   /* ms */
        case TOD_ENUM:   return &UA_TYPES[UA_TYPES_UINT32];  /* ms since midnight */
        case DATE_ENUM:
        case DT_ENUM:    return &UA_TYPES[UA_TYPES_DATETIME];
        case STRING_ENUM: return &UA_TYPES[UA_TYPES_STRING];
        case ENUM_ENUM:  return &UA_TYPES[UA_TYPES_INT32];
        default:         return NULL;
    }
}

static int64_t time_to_ms(const IEC_TIME *t)
{
    return t->tv_sec * 1000 + t->tv_nsec / 1000000;
}

static void ms_to_time(int64_t ms, IEC_TIME *t)
{
    int64_t rem = ms %% 1000;
    t->tv_sec = ms / 1000;
    if(rem < 0){ rem += 1000; t->tv_sec--; }
    t->tv_nsec = rem * 1000000;
}

static UA_StatusCode iec_to_variant(__IEC_types_enum type, opcua_value_t *value, UA_Variant *out)
{
    const UA_DataType *uatype = ua_type(type);
    switch(base_type(type)){
        case BOOL_ENUM: {
            UA_Boolean b = *(IEC_BOOL*)value != 0;
            return UA_Variant_setScalarCopy(out, &b, uatype);
        }
        case TIME_ENUM: {
            UA_Int64 ms = time_to_ms(&value->t);
            return UA_Variant_setScalarCopy(out, &ms, uatype);
        }
        case TOD_ENUM: {
            UA_UInt32 ms = (UA_UInt32)time_to_ms(&value->t);
            return UA_Variant_setScalarCopy(out, &ms, uatype);
        }
        case DATE_ENUM:
        case DT_ENUM: {
            UA_DateTime dt = value->t.tv_sec * UA_DATETIME_SEC +
                             value->t.tv_nsec / 100 + UA_DATETIME_UNIX_EPOCH;
            return UA_Variant_setScalarCopy(out, &dt, uatype);
        }
        case STRING_ENUM: {
            UA_String s = {value->s.len, (UA_Byte*)value->s.body};
            return UA_Variant_setScalarCopy(out, &s, uatype);
        }
        default:
            /* other types have identical C representation */
            return UA_Variant_setScalarCopy(out, value, uatype);
    }
}

static UA_StatusCode variant_to_iec(__IEC_types_enum type, const UA_Variant *in, opcua_value_t *value)
{
    if(!UA_Variant_hasScalarType(in, ua_type(type)))
        return UA_STATUSCODE_BADTYPEMISMATCH;
    switch(base_type(type)){
        case BOOL_ENUM:
            *(IEC_BOOL*)value = *(UA_Boolean*)in->data ? 1 : 0;
            break;
        case TIME_ENUM:
            ms_to_time(*(UA_Int64*)in->data, &value->t);
            break;
        case TOD_ENUM:
            ms_to_time(*(UA_UInt32*)in->data, &value->t);
            break;
        case DATE_ENUM:
        case DT_ENUM: {
            int64_t ticks = *(UA_DateTime*)in->data - UA_DATETIME_UNIX_EPOCH;
            int64_t rem = ticks %% UA_DATETIME_SEC;
            value->t.tv_sec = ticks / UA_DATETIME_SEC;
            if(rem < 0){ rem += UA_DATETIME_SEC; value->t.tv_sec--; }
            value->t.tv_nsec = rem * 100;
            break;
        }
        case STRING_ENUM: {
            UA_String *s = (UA_String*)in->data;
            value->s.len = s->length > STR_MAX_LEN ? STR_MAX_LEN : s->length;
            memcpy(value->s.body, s->data, value->s.len);
            break;
        }
        default:
            memcpy(value, in->data, ua_type(type)->memSize);
    }
    return UA_STATUSCODE_GOOD;
}

/*
 * DataSource callbacks
 */
static UA_StatusCode read_var(UA_Server *server, const UA_NodeId *sessionId, void *sessionContext,
                              const UA_NodeId *nodeId, void *nodeContext,
                              UA_Boolean includeSourceTimeStamp, const UA_NumericRange *range,
                              UA_DataValue *dataValue)
{
    opcua_var_t *var = (opcua_var_t*)nodeContext;
    opcua_value_t value;

    if(range)
        return UA_STATUSCODE_BADINDEXRANGEINVALID;

    memset(&value, 0, sizeof(value));

    /* while building, nodes get a typed default value, without locking */
    if(!building){
        if(var->gen != atomic_load(&active_gen))
            return UA_STATUSCODE_BADWAITINGFORINITIALDATA;
        while(1){
            void *value_p;
            size_t size;
            int done;
            pthread_mutex_lock(&rd_mutex);
            atomic_store(&rd_interrupted, 0);
            IEC_TIME cycle_time = *(volatile IEC_TIME*)&__CURRENT_TIME;
            UnpackVar(var, &value_p, NULL, &size);
            memcpy(&value, value_p, size);
            /* PLC cycle may have started in between, using another extension's
             * retrieve to update located variables before our trylock */
            done = !atomic_load(&rd_interrupted) &&
                   cycle_time.tv_sec == ((volatile IEC_TIME*)&__CURRENT_TIME)->tv_sec &&
                   cycle_time.tv_nsec == ((volatile IEC_TIME*)&__CURRENT_TIME)->tv_nsec;
            pthread_mutex_unlock(&rd_mutex);
            if(done) break;
            wait_plc_cycle_end();
        }
    }

    UA_StatusCode res = iec_to_variant(var->type, &value, &dataValue->value);
    if(res != UA_STATUSCODE_GOOD)
        return res;
    dataValue->hasValue = true;
    if(includeSourceTimeStamp){
        dataValue->sourceTimestamp = UA_DateTime_now();
        dataValue->hasSourceTimestamp = true;
    }
    return UA_STATUSCODE_GOOD;
}

static UA_StatusCode write_var(UA_Server *server, const UA_NodeId *sessionId, void *sessionContext,
                               const UA_NodeId *nodeId, void *nodeContext,
                               const UA_NumericRange *range, const UA_DataValue *dataValue)
{
    opcua_var_t *var = (opcua_var_t*)nodeContext;
    opcua_write_t w;
    UA_StatusCode res;

    if(range)
        return UA_STATUSCODE_BADINDEXRANGEINVALID;
    if(!dataValue->hasValue)
        return UA_STATUSCODE_BADTYPEMISMATCH;
    if(var->gen != atomic_load(&active_gen))
        return UA_STATUSCODE_BADWAITINGFORINITIALDATA;

    w.var = *var;
    res = variant_to_iec(var->type, &dataValue->value, &w.value);
    if(res != UA_STATUSCODE_GOOD)
        return res;

    while(AtomicCompareExchange(&write_lock, 0, 1)) nRT_reschedule();
    if(write_count < WRITE_QUEUE_SIZE)
        write_queue[write_count++] = w;
    else
        res = UA_STATUSCODE_BADRESOURCEUNAVAILABLE;
    AtomicCompareExchange(&write_lock, 1, 0);

    return res;
}

/*
 * Node set population, from instance tree scan
 */
#define MAX_DEPTH 64
#define MAX_PATH 1024

typedef struct {
    UA_NodeId node;
    unsigned int end;     /* cumulated index past last child */
    int is_array;
    size_t path_len;
} scan_level_t;

typedef struct {
    scan_level_t levels[MAX_DEPTH];
    int depth;
    unsigned int pos;     /* cumulated index expected next */
    char path[MAX_PATH];
    uint32_t gen;
} scan_ctx_t;

static UA_StatusCode add_object(char *path, const char *name, const UA_NodeId parent)
{
    UA_ObjectAttributes attr = UA_ObjectAttributes_default;
    attr.displayName = UA_LOCALIZEDTEXT("", (char*)name);
    return UA_Server_addObjectNode(server,
        UA_NODEID_STRING(ns, path), parent,
        UA_NS0ID(HASCOMPONENT), UA_QUALIFIEDNAME(ns, (char*)name),
        UA_NS0ID(BASEOBJECTTYPE), attr, NULL, NULL);
}

static UA_StatusCode add_variable(char *path, const char *name, const UA_NodeId parent,
                                  opcua_var_t *var)
{
    UA_VariableAttributes attr = UA_VariableAttributes_default;
    UA_CallbackValueSource source = {read_var, %(access_rw)d ? write_var : NULL};
    attr.displayName = UA_LOCALIZEDTEXT("", (char*)name);
    attr.dataType = ua_type(var->type)->typeId;
    attr.valueRank = UA_VALUERANK_SCALAR;
    /* clients like asyncua always send source timestamp, that is ignored */
    attr.accessLevel = UA_ACCESSLEVELMASK_READ | (%(access_rw)d ?
        UA_ACCESSLEVELMASK_WRITE | UA_ACCESSLEVELMASK_TIMESTAMPWRITE : 0);
    return UA_Server_addCallbackValueSourceVariableNode(server,
        UA_NODEID_STRING(ns, path), parent,
        UA_NS0ID(HASCOMPONENT), UA_QUALIFIEDNAME(ns, (char*)name),
        UA_NS0ID(BASEDATAVARIABLETYPE), attr, source, var, NULL);
}

static int is_container(__IEC_types_enum type)
{
    return type == FB_ENUM || type == STRUCT_ENUM || type == ARRAY_ENUM;
}

static int scan_cb(__IEC_types_enum type, void *ptr,
                   unsigned int cumulated, unsigned int local,
                   unsigned int count, const char *name, void *userdata)
{
    scan_ctx_t *ctx = (scan_ctx_t*)userdata;
    UA_NodeId parent;
    char index_name[16];
    size_t len;
    UA_StatusCode res;

    /* leave completed containers */
    while(ctx->depth && ctx->levels[ctx->depth - 1].end <= ctx->pos)
        ctx->depth--;

    if(ctx->depth == 0){
        /* top level instance: name is dotted path, create intermediate objects */
        char *dot;
        size_t i;
        UA_NodeId parent_id;
        UA_NodeClass node_class;
        len = strlen(name);
        if(len >= MAX_PATH) goto skip;
        /* IEC identifiers are case insensitive, and members are upper case */
        for(i = 0; i <= len; i++)
            ctx->path[i] = toupper((unsigned char)name[i]);
        parent = root_id;
        for(dot = strchr(ctx->path, '.'); dot; dot = strchr(dot + 1, '.')){
            const char *segment;
            *dot = '\0';
            segment = strrchr(ctx->path, '.');
            segment = segment ? segment + 1 : ctx->path;
            parent_id = UA_NODEID_STRING(ns, ctx->path);
            /* configuration and resource objects are shared by instances */
            if(UA_Server_readNodeClass(server, parent_id, &node_class) != UA_STATUSCODE_GOOD)
                add_object(ctx->path, segment, parent);
            parent = parent_id;
            *dot = '.';
        }
        name = strrchr(ctx->path, '.');
        name = name ? name + 1 : ctx->path;
    } else {
        scan_level_t *level = &ctx->levels[ctx->depth - 1];
        parent = level->node;
        if(level->is_array){
            snprintf(index_name, sizeof(index_name), "[%%u]", count ? local / count : local);
            name = index_name;
            len = level->path_len + strlen(name);
            if(len >= MAX_PATH) goto skip;
            strcpy(ctx->path + level->path_len, name);
        } else {
            len = level->path_len + 1 + strlen(name);
            if(len >= MAX_PATH) goto skip;
            ctx->path[level->path_len] = '.';
            strcpy(ctx->path + level->path_len + 1, name);
        }
    }

    if(is_container(type)){
        if(ctx->depth == MAX_DEPTH) goto skip;
        res = add_object(ctx->path, name, parent);
        if(res != UA_STATUSCODE_GOOD){
            LogWarning("OPC-UA server: cannot publish %%.200s (%%s)", ctx->path, UA_StatusCode_name(res));
            goto skip;
        }
        /* NodeId points to ctx->path, whose first len chars stay unchanged
         * until this level is left */
        scan_level_t *level = &ctx->levels[ctx->depth++];
        level->node = UA_NODEID_STRING(ns, ctx->path);
        level->end = cumulated + count;
        level->is_array = type == ARRAY_ENUM;
        level->path_len = len;
        ctx->pos = cumulated;
        return 1;
    }

    ctx->pos = cumulated + 1;
    if(ua_type(type)){
        opcua_var_t *var = new_var();
        if(!var) return 0;
        var->ptr = ptr;
        var->type = type;
        var->gen = ctx->gen;
        res = add_variable(ctx->path, name, parent, var);
        if(res != UA_STATUSCODE_GOOD)
            LogWarning("OPC-UA server: cannot publish %%.200s (%%s)", ctx->path, UA_StatusCode_name(res));
    }
    return 1;

skip:
    /* step over node, and its children if any */
    ctx->pos = cumulated + count;
    return -1;
}

static UA_StatusCode add_root(void)
{
    UA_ObjectAttributes attr = UA_ObjectAttributes_default;
    attr.displayName = UA_LOCALIZEDTEXT("", %(root_name)s);
    return UA_Server_addObjectNode(server, root_id,
        UA_NS0ID(OBJECTSFOLDER), UA_NS0ID(ORGANIZES),
        UA_QUALIFIEDNAME(ns, %(root_name)s),
        UA_NS0ID(BASEOBJECTTYPE), attr, NULL, NULL);
}

/* Repeated callback, in server thread: rebuild node set when logic changed */
static void rebuild_nodes(UA_Server *s, void *data)
{
    static scan_ctx_t ctx;
    uint32_t gen = atomic_load(&active_gen);
    scan_fn_t scan = active_scan;

    if(gen == built_gen || !scan)
        return;

    UA_Server_deleteNode(server, root_id, true);
    free_vars();
    add_root();

    memset(&ctx, 0, sizeof(ctx));
    ctx.gen = gen;
    building = 1;
    scan(scan_cb, &ctx, 0);
    building = 0;

    built_gen = gen;
    LogInfo("OPC-UA server: %%u variables published", var_count);
}

static UA_StatusCode configure(UA_ServerConfig *config)
{
    UA_StatusCode res;
    const char *interface = %(interface)s;

#ifdef OPCUA_SECURITY
    UA_ByteString certificate = {sizeof(server_cert), server_cert};
    UA_ByteString private_key = {sizeof(server_key), server_key};
    if(OPCUA_TRUST_LIST_SIZE == 0)
        LogWarning("OPC-UA server: empty trust list, any client certificate is accepted");
    res = (OPCUA_ALLOW_NONE_POLICY ?
           UA_ServerConfig_setDefaultWithSecurityPolicies :
           UA_ServerConfig_setDefaultWithSecureSecurityPolicies)(
        config, %(port)d, &certificate, &private_key,
        trust_list, OPCUA_TRUST_LIST_SIZE, NULL, 0, NULL, 0);
    /* without None policy endpoints, keep it for clients to discover endpoints */
    if(res == UA_STATUSCODE_GOOD && !OPCUA_ALLOW_NONE_POLICY){
        res = UA_ServerConfig_addSecurityPolicyNone(config, &certificate);
        config->securityPolicyNoneDiscoveryOnly = true;
    }
#else
    res = UA_ServerConfig_setMinimal(config, %(port)d, NULL);
#endif
    if(res != UA_STATUSCODE_GOOD)
        return res;

    /* bind given interface only */
    if(*interface){
        char url[256];
        snprintf(url, sizeof(url), "opc.tcp://%%s:%%d", interface, %(port)d);
        UA_Array_delete(config->serverUrls, config->serverUrlsSize, &UA_TYPES[UA_TYPES_STRING]);
        config->serverUrls = UA_String_new();
        *config->serverUrls = UA_STRING_ALLOC(url);
        config->serverUrlsSize = 1;
    }

    UA_String_clear(&config->applicationDescription.applicationUri);
    config->applicationDescription.applicationUri = UA_STRING_ALLOC(%(application_uri)s);

#ifdef OPCUA_USER
    UA_UsernamePasswordLogin logins[1] = {{UA_STRING(OPCUA_USER), UA_STRING(OPCUA_PASSWORD)}};
#ifndef OPCUA_SECURITY
    LogWarning("OPC-UA server: password is transmitted unencrypted");
    config->allowNonePolicyPassword = true;
#endif
    return UA_AccessControl_default(config, %(allow_anonymous)d, NULL, 1, logins);
#else
    return UA_AccessControl_default(config, %(allow_anonymous)d, NULL, 0, NULL);
#endif
}

static void *server_thread_proc(void *arg)
{
    UA_StatusCode res = UA_Server_run(server, &server_running);
    if(res != UA_STATUSCODE_GOOD){
        LogError("OPC-UA server stopped: %%s", UA_StatusCode_name(res));
    }
    return NULL;
}

int __init_%(locstr)s(int argc, char **argv)
{
    UA_ServerConfig config;
    UA_StatusCode res;
    int rc;

    memset(&config, 0, sizeof(config));
    res = configure(&config);
    if(res != UA_STATUSCODE_GOOD){
        LogError("OPC-UA server configuration failed: %%s", UA_StatusCode_name(res));
        UA_ServerConfig_clear(&config);
        return EXIT_FAILURE;
    }

    server = UA_Server_newWithConfig(&config);
    if(!server){
        LogError("OPC-UA server creation failed");
        return EXIT_FAILURE;
    }

    ns = UA_Server_addNamespace(server, %(namespace)s);
    add_root();
    /* node set is (re)built in server thread once PLC logic is active,
     * or immediately when restarting with already active logic */
    built_gen = 0;
    UA_Server_addRepeatedCallback(server, rebuild_nodes, NULL, 100, NULL);

    server_running = true;
    rc = pthread_create(&server_thread, NULL, server_thread_proc, NULL);
    if(rc != 0){
        LogError("OPC-UA server: failed to create thread: %%d", rc);
        UA_Server_delete(server);
        server = NULL;
        return EXIT_FAILURE;
    }
    LogInfo("OPC-UA server started on port %%d", %(port)d);
    return 0;
}

void __cleanup_%(locstr)s(void)
{
    if(!server)
        return;
    server_running = false;
    pthread_join(server_thread, NULL);
    UA_Server_delete(server);
    server = NULL;
    free_vars();
}

/* PLC thread */
void __retrieve_%(locstr)s(void)
{
    if(pthread_mutex_trylock(&rd_mutex) == 0){
        plc_locked = PLC_LOCKED;
    } else {
        if(pthread_mutex_trylock(&cycle_end_mutex) == 0)
            plc_locked = PLC_INTERRUPTING;
        atomic_store(&rd_interrupted, 1);
    }

    /* apply writes buffered by server thread */
    if(!AtomicCompareExchange(&write_lock, 0, 1)){
        uint32_t gen = atomic_load(&active_gen);
        unsigned int i;
        for(i = 0; i < write_count; i++){
            opcua_write_t *w = &write_queue[i];
            void *value_p;
            char flags;
            size_t size;
            /* drop writes to variables of a swapped out logic */
            if(w->var.gen != gen) continue;
            UnpackVar(&w->var, &value_p, &flags, &size);
            if(!(flags & __IEC_FORCE_FLAG))
                memcpy(value_p, &w->value, size);
        }
        write_count = 0;
        AtomicCompareExchange(&write_lock, 1, 0);
    }
}

/* PLC thread */
void __publish_%(locstr)s(void)
{
    if(plc_locked == PLC_LOCKED)
        pthread_mutex_unlock(&rd_mutex);
    else if(plc_locked == PLC_INTERRUPTING)
        pthread_mutex_unlock(&cycle_end_mutex);
    plc_locked = PLC_IDLE;
}

/* Main thread: logic .so loaded, or about to be hot-swapped in */
void __logic_bound_%(locstr)s(void *handle)
{
    pending_scan = (scan_fn_t)dlsym(handle, "ScanInstances");
}

/* Logic .so became active. PLC thread in case of hot-swap */
void __logic_active_%(locstr)s(void)
{
    active_scan = pending_scan;
    atomic_fetch_add(&active_gen, 1);
}
